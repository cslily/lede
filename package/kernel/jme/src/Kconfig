## package/kernel/jme/src/Kconfig
```kconfig
config JMC
	tristate "JMicron PCI Express Gigabit Ethernet Adapter driver"
	help
　            The jme device driver provides support for JMicron JMC25x PCI Express Gigabit Ethernet controllers.
```
